## Documentation/devicetree/bindings/clock/fsl,imx-blk-ctl.yaml
```yaml
# SPDX-License-Identifier: (GPL-2.0-only OR BSD-2-Clause)
%YAML 1.2
---
$id: http://devicetree.org/schemas/clock/fsl,imx-blk-ctl.yaml#
$schema: http://devicetree.org/meta-schemas/core.yaml#

title: NXP i.MX BLK_CTL

maintainers:
  - Abel Vesa <abel.vesa@nxp.com>

description:
  i.MX BLK_CTL is a conglomerate of different GPRs that are
  dedicated to a specific subsystem. Because it usually contains
  clocks amongst other things, it needs access to the i.MX clocks
  API. All the other functionalities it provides can work just fine
  from the clock subsystem tree.

properties:
  compatible:
    items:
      - enum:
         - fsl,imx8mm-dispmix-blk-ctl
         - fsl,imx8mp-audio-blk-ctl
         - fsl,imx8mp-hdmi-blk-ctl
         - fsl,imx8mp-media-blk-ctl
      - const: syscon

  reg:
    maxItems: 1

  power-domains:
    maxItems: 1

  '#clock-cells':
    const: 1

  '#reset-cells':
    const: 1

required:
  - compatible
  - reg
  - power-domains
  - '#clock-cells'
  - '#reset-cells'

additionalProperties: false

examples:
  - |
    #include <dt-bindings/clock/imx8mp-clock.h>

    audio_blk_ctl: clock-controller@30e20000 {
       compatible = "fsl,imx8mp-audio-blk-ctl", "syscon";
       reg = <0x30e20000 0x10000>;
       power-domains = <&audiomix_pd>;

       #clock-cells = <1>;
       #reset-cells = <1>;
    };
```

## Documentation/devicetree/bindings/input/touchscreen/dfr0550.yaml
```yaml
# SPDX-License-Identifier: (GPL-2.0-only OR BSD-2-Clause)
%YAML 1.2
---
$id: http://devicetree.org/schemas/input/touchscreen/dfr0550.yaml#
$schema: http://devicetree.org/meta-schemas/core.yaml#

title: DFRobot DFR0550 Touch Controller Bindings

maintainers:
  - Tim Harvey <tharvey@gateworks.com>

allOf:
  - $ref: touchscreen.yaml#

properties:
  compatible:
    const: dfr,dfr0550

  reg:
    maxItems: 1

  poll-interval:
    description: Poll interval time in milliseconds.
    $ref: /schemas/types.yaml#/definitions/uint32

  touchscreen-size-x: true
  touchscreen-size-y: true
  touchscreen-fuzz-x: true
  touchscreen-fuzz-y: true
  touchscreen-inverted-x: true
  touchscreen-inverted-y: true
  touchscreen-swapped-x-y: true

additionalProperties: false

required:
  - compatible
  - reg
  - poll-interval

examples:
  - |
    i2c {
      #address-cells = <1>;
      #size-cells = <0>;

      touchscreen@38 {
        compatible = "dfr,dfr0550";
        reg = <0x38>;
      };
    };

...
```
