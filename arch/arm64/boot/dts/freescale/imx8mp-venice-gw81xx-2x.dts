// SPDX-License-Identifier: (GPL-2.0+ OR MIT)
/*
 * Copyright 2026 Gateworks Corporation
 */

/dts-v1/;

#include "imx8mp.dtsi"
#include "imx8mp-venice-gw702x.dtsi"
#include "imx8mp-venice-gw81xx.dtsi"

/ {
	compatible = "gateworks,imx8mp-gw81xx-2x", "fsl,imx8mp";
	model = "Gateworks Venice GW81xx-2x i.MX8MP Development Kit";

	chosen {
		stdout-path = &uart2;
	};
};
